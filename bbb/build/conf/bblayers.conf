## bbb/build/conf/bblayers.conf
```bitbake
# POKY_BBLAYERS_CONF_VERSION is increased each time build/conf/bblayers.conf
# changes incompatibly
POKY_BBLAYERS_CONF_VERSION = "2"

BBB_YOCTO_DIR="/home/duanlv/git-workspace/bbb_yocto"
BBPATH = "${TOPDIR}"
BBFILES ?= ""

BBLAYERS ?= " \
  ${BBB_YOCTO_DIR}/poky-thud/meta \
  ${BBB_YOCTO_DIR}/poky-thud/meta-poky \
  ${BBB_YOCTO_DIR}/poky-thud/meta-openembedded/meta-oe \
  ${BBB_YOCTO_DIR}/poky-thud/meta-openembedded/meta-networking \
  ${BBB_YOCTO_DIR}/poky-thud/meta-openembedded/meta-python \
  ${BBB_YOCTO_DIR}/poky-thud/meta-qt5 \
  ${BBB_YOCTO_DIR}/bbb/meta-bbb \
"
```
